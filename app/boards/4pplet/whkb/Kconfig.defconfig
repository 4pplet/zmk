## app/boards/4pplet/whkb/Kconfig.defconfig
```kconfig
# Copyright (c) 2025 Stefan Sundin (4pplet)
# SPDX-License-Identifier: MIT

if BOARD_WHKB

config ZMK_KEYBOARD_NAME
    default "WHKB"

if USB

config USB_NRFX
    default y

config USB_DEVICE_STACK
    default y

config USB_DEVICE_MANUFACTURER
    default "4pplet"

endif # USB

if BT

config BT_DIS_MANUF
    default "4pplet"

config BT_DIS_MODEL
    default "WHKB"

endif # BT

config BT_CTLR
    default BT

config ZMK_BLE
    default y

config ZMK_USB
    default y

endif # BOARD_WHKB
```

## app/boards/4pplet/whkb/Kconfig.whkb
```kconfig
# Copyright (c) 2025 Stefan Sundin (4pplet)
# SPDX-License-Identifier: MIT

config BOARD_WHKB
    select SOC_NRF52840_QIAA
    imply RETAINED_MEM
    imply RETENTION
    imply RETENTION_BOOT_MODE

rsource "drivers/Kconfig"
```

## app/boards/4pplet/whkb/board.yml
```yaml
board:
  name: whkb
  vendor: 4pplet
  socs:
    - name: nrf52840
  revision:
    format: custom
    default: rev_b
    revisions:
      - name: rev_b
      - name: rev_b_jp
```

## app/boards/4pplet/whkb/drivers/kscan/Kconfig
```kconfig
# Copyright (c) 2025 Stefan Sundin (4pplet)
# SPDX-License-Identifier: MIT

config ZMK_KSCAN_GPIO_TOPRE
    bool "Topre capacitive keyboard GPIO driver"
    default y
    depends on DT_HAS_ZMK_KSCAN_GPIO_TOPRE_ENABLED
    select GPIO
    help
      Enable GPIO-based Topre capacitive keyboard scanner driver.

config ZMK_KSCAN_GPIO_TOPRE_DEBUG
    bool "Topre kscan debug logging"
    depends on ZMK_KSCAN_GPIO_TOPRE
    help
      Enable verbose debug logging for Topre keyboard scanning.
```

## app/boards/4pplet/whkb_pro2/Kconfig.defconfig
```kconfig
# Copyright (c) 2025 Stefan Sundin (4pplet)
# SPDX-License-Identifier: MIT

if BOARD_WHKB_PRO2

config ZMK_KEYBOARD_NAME
    default "WHKB Pro2"

if USB

config USB_NRFX
    default y

config USB_DEVICE_STACK
    default y

config USB_DEVICE_MANUFACTURER
    default "4pplet"

endif # USB

if BT

config BT_DIS_MANUF
    default "4pplet"

config BT_DIS_MODEL
    default "WHKB Pro2"

endif # BT

config BT_CTLR
    default BT

config ZMK_BLE
    default y

config ZMK_USB
    default y

endif # BOARD_WHKB_PRO2
```

## app/boards/4pplet/whkb_pro2/Kconfig.whkb_pro2
```kconfig
# Copyright (c) 2025 Stefan Sundin (4pplet)
# SPDX-License-Identifier: MIT

config BOARD_WHKB_PRO2
    select SOC_NRF52840_QIAA
    imply RETAINED_MEM
    imply RETENTION
    imply RETENTION_BOOT_MODE

config WHKB_PRO2_POWER
    bool "WHKB Pro2 power management"
    help
      Enable ADXL362 GPIO power control and sleep guard for WHKB Pro2 (Rev B).
      This power-cycles the accelerometer on P0.28 during init and prevents
      sleep if no wakeup source is available.

rsource "drivers/Kconfig"
```

## app/boards/4pplet/whkb_pro2/board.yml
```yaml
board:
  name: whkb_pro2
  vendor: 4pplet
  socs:
    - name: nrf52840
  revision:
    format: custom
    default: rev_b
    revisions:
      - name: rev_b
      - name: rev_b_jp
```

## app/boards/4pplet/whkb_pro2/dts/bindings/kscan/zmk,kscan-gpio-topre.yaml
```yaml
# Copyright (c) 2022 Kan-Ru Chen
# Copyright (c) 2025 Stefan Sundin (4pplet)
# SPDX-License-Identifier: MIT

description: GPIO Topre capacitive keyboard controller

compatible: "zmk,kscan-gpio-topre"

include: kscan.yaml

properties:
  gpios:
    type: phandle-array
    required: true
    description: |
      GPIO pins for the Topre controller. Must be 10 pins in this order:
      0: POWER - Power control for the controller board
      1: KEY - Key sense input
      2: HYS - Hysteresis control
      3-8: BIT0-BIT5 - Selection bits for row/column
      9: STROBE - Strobe signal
  matrix-relax-us:
    type: int
    default: 6
    description: Microseconds to wait after setting selection bits
  adc-read-settle-us:
    type: int
    default: 5
    description: Microseconds to wait after strobe before reading key state
  active-polling-interval-ms:
    type: int
    default: 8
    description: Polling interval in milliseconds when keyboard is active
  idle-polling-interval-ms:
    type: int
    default: 30
    description: Polling interval in milliseconds when keyboard is idle
  sleep-polling-interval-ms:
    type: int
    default: 3000
    description: Polling interval in milliseconds when keyboard is in sleep mode
  row-enable-low-gpios:
    type: phandle-array
    required: false
    description: |
      GPIO pin for JP Z2 multiplexer enable (rows 0-7). Active low.
      Only required for HHKB JP variant.
  row-enable-high-gpios:
    type: phandle-array
    required: false
    description: |
      GPIO pin for JP Z3 multiplexer enable (rows 8-15). Active low.
      Only required for HHKB JP variant.
  matrix-rows:
    type: int
    default: 8
    description: Number of rows in the matrix (8 for ANSI, 16 for JP)
  matrix-cols:
    type: int
    default: 8
    description: Number of columns in the matrix
```

## app/boards/4pplet/whkb_pro3/Kconfig.defconfig
```kconfig
# Copyright (c) 2025 Stefan Sundin (4pplet)
# SPDX-License-Identifier: MIT

if BOARD_WHKB_PRO3

config ZMK_KEYBOARD_NAME
    default "WHKB Pro3"

config USB_DEVICE_VID
    default 0x4444

config USB_DEVICE_PID
    default 0x0031

config USB_DEVICE_MANUFACTURER
    default "4pplet"

config BT_CTLR
    default BT

config ZMK_BLE
    default y

config ZMK_USB
    default y

endif # BOARD_WHKB_PRO3
```

## app/boards/4pplet/whkb_pro3/board.yml
```yaml
board:
  name: whkb_pro3
  vendor: 4pplet
  socs:
    - name: nrf52840
  revision:
    format: custom
    default: ansi
    revisions:
      - name: ansi
      - name: jp
```

## app/boards/4pplet/whkb_pro3/drivers/Kconfig
```kconfig
# Copyright (c) 2025 Stefan Sundin (4pplet)
# SPDX-License-Identifier: MIT

rsource "kscan/Kconfig"
```

## app/boards/4pplet/whkb_pro3/drivers/kscan/Kconfig
```kconfig
# Copyright (c) 2025 Stefan Sundin (4pplet)
# SPDX-License-Identifier: MIT

config ZMK_KSCAN_TOPRE_ADC
    bool "ADC-based Topre kscan driver"
    default y
    depends on DT_HAS_ZMK_KSCAN_TOPRE_ADC_ENABLED
    depends on GPIO
    depends on ADC
    help
      Enable ADC-based Topre electrostatic capacitive sensing driver.
      Uses analog OpAmp output with ADC instead of digital comparator.
```

## app/boards/4pplet/whkb_pro3/dts/bindings/kscan/zmk,kscan-topre-adc.yaml
```yaml
# Copyright (c) 2025 Stefan Sundin (4pplet)
# SPDX-License-Identifier: MIT

description: |
  ADC-based Topre electrostatic capacitive kscan driver for WHKB Pro3.
  Uses analog sensing via OpAmp and ADC instead of digital comparator.

compatible: "zmk,kscan-topre-adc"

include: kscan.yaml

properties:
  row-gpios:
    type: phandle-array
    required: true
    description: |
      GPIO pins for row drive (active high).
      Must have exactly 4 entries for the 4 rows.

  col-sel-gpios:
    type: phandle-array
    required: true
    description: |
      GPIO pins for 3-bit column address (COL_A, COL_B, COL_C).
      Must have exactly 3 entries.

  u1-en-gpios:
    type: phandle-array
    required: true
    description: |
      GPIO for U1 mux enable (columns 0-7).
      Should be configured as active-low in DT if the mux uses active-low enable.

  u2-en-gpios:
    type: phandle-array
    required: true
    description: |
      GPIO for U2 mux enable (columns 8-14).
      Should be configured as active-low in DT if the mux uses active-low enable.

  opamp-en-gpios:
    type: phandle-array
    required: true
    description: GPIO for OpAmp enable (active high).

  discharge-gpios:
    type: phandle-array
    required: true
    description: GPIO for sample capacitor discharge (active high).

  power-gpios:
    type: phandle-array
    required: true
    description: GPIO for switch board power control (active high).

  io-channels:
    type: phandle-array
    required: true
    description: ADC channel for analog sense input.

  actuation-threshold-mv:
    type: int
    required: true
    description: |
      Actuation threshold in millivolts.
      Keys with ADC reading below this value are considered pressed.
      Typical values: 800-1200mV depending on key wear and calibration.

  row-drive-us:
    type: int
    default: 20
    description: Row drive pulse width in microseconds.

  row-settle-us:
    type: int
    default: 80
    description: Time between row drives in microseconds.

  opamp-settle-us:
    type: int
    default: 22
    description: OpAmp enable settling time in microseconds.

  discharge-us:
    type: int
    default: 7
    description: Capacitor discharge time in microseconds.

  active-polling-interval-ms:
    type: int
    default: 8
    description: Polling interval in milliseconds when keyboard is active.

  idle-polling-interval-ms:
    type: int
    default: 100
    description: Polling interval in milliseconds when keyboard is idle.
```

## app/boards/4pplet/whkb_pro3/whkb_pro3_defconfig
```kconfig
# Copyright (c) 2025 Stefan Sundin (4pplet)
# SPDX-License-Identifier: MIT

CONFIG_MPU_ALLOW_FLASH_WRITE=y
CONFIG_NVS=y
CONFIG_SETTINGS_NVS=y
CONFIG_FLASH=y
CONFIG_FLASH_PAGE_LAYOUT=y
CONFIG_FLASH_MAP=y

# Enable MPU
CONFIG_ARM_MPU=y

# Enable GPIO
CONFIG_GPIO=y

# Use P0.09 and P0.10 as GPIO instead of NFC
CONFIG_NFCT_PINS_AS_GPIOS=y

# Enable ADC for capacitive sensing
CONFIG_ADC=y

# Enable PWM for buzzer
CONFIG_PWM=y

# Build uf2
CONFIG_USE_DT_CODE_PARTITION=y
CONFIG_BUILD_OUTPUT_UF2=y

# Topre ADC driver
CONFIG_ZMK_KSCAN_TOPRE_ADC=y

# USB CDC-ACM for logging
CONFIG_USB_CDC_ACM=y
CONFIG_SERIAL=y
CONFIG_UART_INTERRUPT_DRIVEN=y
CONFIG_UART_LINE_CTRL=y

# USB serial logging for debugging
CONFIG_LOG=y
CONFIG_ZMK_USB_LOGGING=y
CONFIG_LOG_DEFAULT_LEVEL=2
CONFIG_ZMK_LOG_LEVEL_INF=y
```
