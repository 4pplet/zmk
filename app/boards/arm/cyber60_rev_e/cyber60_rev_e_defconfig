## app/boards/arm/cyber60_rev_e/cyber60_rev_e_defconfig
```kconfig
# SPDX-License-Identifier: MIT

CONFIG_SOC_SERIES_NRF52X=y
CONFIG_SOC_NRF52840_QIAA=y
CONFIG_BOARD_CYBER60_REV_E=y

# Enable MPU
CONFIG_ARM_MPU=y

# Enable GPIO
CONFIG_GPIO=y

CONFIG_USE_DT_CODE_PARTITION=y
CONFIG_BUILD_OUTPUT_UF2=y

# Enable PWM
CONFIG_PWM=y
CONFIG_PWM_NRFX=y

CONFIG_MPU_ALLOW_FLASH_WRITE=y
CONFIG_NVS=y
CONFIG_SETTINGS_NVS=y
CONFIG_FLASH=y
CONFIG_FLASH_PAGE_LAYOUT=y
CONFIG_FLASH_MAP=y

# Set TX power level
# CONFIG_BT_CTLR_TX_PWR_PLUS_8=y  # Recommended if used in a metal enclosure

# Enable Underglow
CONFIG_ZMK_RGB_UNDERGLOW=y
CONFIG_WS2812_STRIP=y
CONFIG_ZMK_RGB_UNDERGLOW_EXT_POWER=y
CONFIG_ZMK_RGB_UNDERGLOW_ON_START=n

# Enable the rotary encoder
CONFIG_EC11=y
CONFIG_EC11_TRIGGER_GLOBAL_THREAD=y

# Enable sleep
CONFIG_ZMK_SLEEP=n
# CONFIG_ZMK_IDLE_SLEEP_TIMEOUT=120000

# Enable pinctrl
CONFIG_PINCTRL=y

# Turn on logging, and set ZMK logging to debug output
CONFIG_LOG_PROCESS_THREAD_STARTUP_DELAY_MS=8000
CONFIG_ZMK_USB_LOGGING=y

CONFIG_ZMK_STUDIO=y
CONFIG_ZMK_STUDIO_LOCKING=n

# Disable I2C (for now)
CONFIG_I2C=y
CONFIG_I2C_NRFX=y

# Enable battery monitoring (ZMK)
CONFIG_ZMK_BATTERY=y

# Internal RTC
# CONFIG_CLOCK_CONTROL_NRF_K32SRC_RC=y
# CONFIG_CLOCK_CONTROL_NRF_K32SRC_250PPM=y

# External RTC
CONFIG_CLOCK_CONTROL_NRF_K32SRC_RC=n
CONFIG_CLOCK_CONTROL_NRF_K32SRC_XTAL=y
CONFIG_CLOCK_CONTROL_NRF_K32SRC_50PPM=y
# CONFIG_CLOCK_CONTROL_NRF_K32SRC_NO_WAIT=n
# CONFIG_CLOCK_CONTROL_NRF_K32SRC_DELAY=500
# CONFIG_CLOCK_CONTROL_NRF_FORCE_ALT=y


# Ensure system clock starts without waiting for LFCLK stability
# CONFIG_SYSTEM_CLOCK_NO_WAIT=y
CONFIG_SYSTEM_CLOCK_INIT_PRIORITY=0

# Global logging configuration
CONFIG_LOG=y
CONFIG_LOG_MODE_DEFERRED=y
CONFIG_LOG_DEFAULT_LEVEL=3
CONFIG_CLOCK_CONTROL_LOG_LEVEL_DBG=y
```

## app/boards/arm/cyber80_rev_a/Kconfig.board
```kconfig
# cyber60 board configuration

# Copyright (c) 2024 Stefan Sundin (4pplet)
# SPDX-License-Identifier: MIT

config BOARD_CYBER80_REV_A
	bool "cyber80 Rev A"
	depends on SOC_NRF52840_QIAA
```
